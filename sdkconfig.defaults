## sdkconfig.defaults
```kconfig
# uncomment one of these if you want to support a specifc target by default
# CONFIG_IDF_TARGET="esp32"
# CONFIG_IDF_TARGET="esp32s2"
# CONFIG_IDF_TARGET="esp32s3"
# CONFIG_IDF_TARGET="esp32c3"

CONFIG_FREERTOS_HZ=1000

# ESP32-specific
#
CONFIG_ESP_DEFAULT_CPU_FREQ_MHZ_240=y
CONFIG_ESP_DEFAULT_CPU_FREQ_MHZ=240

# Common ESP-related
#
CONFIG_ESP_SYSTEM_EVENT_TASK_STACK_SIZE=4096
CONFIG_ESP_MAIN_TASK_STACK_SIZE=8192

#
# BT config
#
CONFIG_BT_ENABLED=y
CONFIG_BT_BLUEDROID_ENABLED=n
CONFIG_BT_NIMBLE_ENABLED=y
CONFIG_BT_NIMBLE_LOG_LEVEL_NONE=y
CONFIG_BT_NIMBLE_NVS_PERSIST=y
CONFIG_BT_NIMBLE_GAP_DEVICE_NAME_MAX_LEN=100
CONFIG_BT_NIMBLE_HOST_TASK_STACK_SIZE=8192

# Set the default Tx power level (P9 = +9dBm = the default)
# CONFIG_BT_CTRL_DFT_TX_POWER_LEVEL_P9=y

# Support modem sleep (low power mode)
# CONFIG_BT_CTRL_MODEM_SLEEP=y

# Set the ESP-NIMBLE-CPP Config
CONFIG_NIMBLE_CPP_LOG_LEVEL_NONE=y
```
